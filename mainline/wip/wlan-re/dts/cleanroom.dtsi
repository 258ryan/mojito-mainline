/* Append to sm6150-xiaomi-mojito.dts to rebuild this test tree (7.2.10 also needs <dt-bindings/firmware/qcom,scm.h> before talos.dtsi). */
/* TEST cleanroom: Wi-Fi exactly as sm7125-mainline's Xiaomi miatoll (+ sc7180.dtsi), clipped to mojito stock voltages */
/ {
	/delete-node/ wcn3990-pmu;
};

&remoteproc_mpss {
	/delete-property/ pinctrl-names;
	/delete-property/ pinctrl-0;
};

/delete-node/ &cnss_wlan_en_active;

&vreg_l9a {
	regulator-min-microvolt = <488000>;
};

&vreg_l10a {
	/delete-property/ regulator-always-on;
};

&{/soc@0/wifi@18800000} {
	qcom,msa-fixed-perm;
	vdd-0.8-cx-mx-supply = <&vreg_l9a>;
	vdd-1.8-xo-supply = <&vreg_l1c>;
	vdd-1.3-rfa-supply = <&vreg_l2c>;
	vdd-3.3-ch0-supply = <&vreg_l10c>;
	vdd-3.3-ch1-supply = <&vreg_l11c>;
	status = "okay";
};
